## conf/layer.conf
```bitbake
# We have a conf and classes directory, add to BBPATH
BBPATH .= ":${LAYERDIR}"

# We have recipes-* directories, add to BBFILES
BBFILES += "${LAYERDIR}/recipes-*/*/*.bb \
            ${LAYERDIR}/recipes-*/*/*.bbappend"

BBFILE_COLLECTIONS += "meta-db1"
BBFILE_PATTERN_meta-db1 = "^${LAYERDIR}/"
BBFILE_PRIORITY_meta-db1 = "6"

LAYERDEPENDS_meta-db1 = "core meta-arm"
LAYERSERIES_COMPAT_meta-db1 = "kirkstone mickledore"
```

## conf/machine/db1.conf
```bitbake
DEFAULTTUNE ?= "cortexa53-crypto"

require conf/machine/include/arm/armv8a/tune-cortexa53.inc

PREFERRED_PROVIDER_virtual/kernel ?= "linux-db1"
PREFERRED_PROVIDER_u-boot ?= "u-boot"
PREFERRED_PROVIDER_virtual/bootloader ?= "u-boot"

KERNEL_IMAGETYPE ?= "Image"

UBOOT_LOCALVERSION = "-g${@d.getVar('SRCPV', True).partition('+')[2][0:7]}"

IMAGE_FSTYPES += "ext3 tar.gz wic.gz wic.bmap"

IMAGE_BOOT_FILES ?= "${KERNEL_IMAGETYPE} boot.scr db1_07c.dtb"
CORE_IMAGE_EXTRA_INSTALL += "i2c-tools kernel-modules"
IMAGE_INSTALL:append = " iw \
                         networkmanager \
                         networkmanager-nmcli \
                         wpa-supplicant \
                         wireless-regdb-static \
                         linux-firmware-db1-mixed \
                         dbus \
                         libusb1 \
                         modem \
                         egpio"

KERNEL_DEVICETREE = "qcom_db1/db1_07c.dtb"

SERIAL_CONSOLES ?= "115200;ttyMSM0"
SERIAL_CONSOLES_CHECK = "${SERIAL_CONSOLES}"

INIT_MANAGER = "systemd"
```
